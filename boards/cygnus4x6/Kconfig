## boards/cygnus4x6/Kconfig.cygnus4x6_right
```kconfig
config BOARD_CYGNUS4X6_RIGHT
    select SOC_NRF52840_QIAA
    imply RETAINED_MEM
    imply RETENTION
    imply RETENTION_BOOT_MODE
```

## boards/shields/cygnus4x6/Kconfig.defconfig
```kconfig
if SHIELD_CYGNUS4X6_LEFT

config ZMK_KEYBOARD_NAME
    default "cygnus4x6"

config ZMK_SPLIT_ROLE_CENTRAL
    default y

endif # SHIELD_CYGNUS4X6_LEFT

if SHIELD_CYGNUS4X6_LEFT || SHIELD_CYGNUS4X6_RIGHT

config ZMK_SPLIT
    default y

endif # SHIELD_CYGNUS4X6_LEFT || SHIELD_CYGNUS4X6_RIGHT
```

## boards/shields/cygnus4x6/Kconfig.shield
```kconfig
config SHIELD_CYGNUS4X6_LEFT
    def_bool $(shields_list_contains,cygnus4x6_left)

config SHIELD_CYGNUS4X6_RIGHT
    def_bool $(shields_list_contains,cygnus4x6_right)
#
# No whitespace after the comma or in the keyboard name!
config SHIELD_CYGNUS4X6_DONGLE
    def_bool $(shields_list_contains,cygnux4x6_dongle)
```
