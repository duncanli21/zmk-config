// This file was generated from a template. Edit it to match your keyboard.
// See https://zmk.dev/docs/development/hardware-integration/new-shield for more
// instructions.

#include "cygnus4x6.dtsi"

&kscan {
    // Replace these comments with the GPIO pins in the matrix for the left side.
    // See https://zmk.dev/docs/development/hardware-integration/new-shield#shield-overlays
    /* row-gpios */
    /*     = <&pro_micro 3 (GPIO_ACTIVE_HIGH | GPIO_PULL_DOWN)> */
    /*     , <&pro_micro 4 (GPIO_ACTIVE_HIGH | GPIO_PULL_DOWN)> */
    /*     , <&pro_micro 5 (GPIO_ACTIVE_HIGH | GPIO_PULL_DOWN)> */
    /*     , <&pro_micro 6 (GPIO_ACTIVE_HIGH | GPIO_PULL_DOWN)> */
    /*     , <&pro_micro 7 (GPIO_ACTIVE_HIGH | GPIO_PULL_DOWN)> */
    /*     ; */
    col-gpios
        = <&pro_micro 21 GPIO_ACTIVE_HIGH>
        , <&pro_micro 20 GPIO_ACTIVE_HIGH>
        , <&pro_micro 19 GPIO_ACTIVE_HIGH>
        , <&pro_micro 18 GPIO_ACTIVE_HIGH>
        , <&pro_micro 15 GPIO_ACTIVE_HIGH>
        , <&pro_micro 14 GPIO_ACTIVE_HIGH>
        ;
};
