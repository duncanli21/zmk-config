// This file was generated from a template. Edit it to match your keyboard.
// See https://zmk.dev/docs/development/hardware-integration/new-shield for more
// instructions.

#include "cygnus4x6.dtsi"

&default_transform {
    // Set this to the number of columns on the left side.
    col-offset = <6>;
};

 &kscan {
     // Replace these comments with the GPIO pins in the matrix for the right side. 
     // See https://zmk.dev/docs/development/hardware-integration/new-shield#shield-overlays 
    /* row-gpios */
    /*     = <&pro_micro 4 (GPIO_ACTIVE_HIGH | GPIO_PULL_DOWN)> */
    /*     , <&pro_micro 5 (GPIO_ACTIVE_HIGH | GPIO_PULL_DOWN)> */
    /*     , <&pro_micro 6 (GPIO_ACTIVE_HIGH | GPIO_PULL_DOWN)> */
    /*     , <&pro_micro 7 (GPIO_ACTIVE_HIGH | GPIO_PULL_DOWN)> */
    /*     , <&pro_micro 8 (GPIO_ACTIVE_HIGH | GPIO_PULL_DOWN)> */
    /*     ; */
 }; 
